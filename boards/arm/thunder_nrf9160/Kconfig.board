## boards/arm/thunder_nrf9160/Kconfig.board
```kconfig
# Thunder nRF9160 board configuration

# Copyright (c) 2018-2020 Nordic Semiconductor ASA
# SPDX-License-Identifier: Apache-2.0

if SOC_NRF9160_SICA

config BOARD_THUNDER_NRF9160
	bool "Thunder nRF9160"

config BOARD_THUNDER_NRF9160_NS
	bool "Thunder nRF9160 non-secure"

endif # SOC_NRF9160_SICA
```
